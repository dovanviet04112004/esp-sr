## firmware/components/ai_engine/Kconfig
```kconfig
menu "ai_engine"

    choice AI_ENGINE_COMMAND_BACKEND
        prompt "command backend (KEHOACH 3.12, ADR-0012)"
        default AI_ENGINE_COMMAND_BACKEND_KWS
        help
            Which command directory builds into ai_engine; the model image names its command entries after it.

        config AI_ENGINE_COMMAND_BACKEND_KWS
            bool "kws: src/command/, a neutral shell until E11-T17 runs its net"

        config AI_ENGINE_COMMAND_BACKEND_CTC
            bool "ctc: src/command_ctc/, the streaming encoder and the constrained CTC decision"

        config AI_ENGINE_COMMAND_BACKEND_RNNT
            bool "rnnt: src/command_rnnt/, the ctc encoder with a predictor and a joiner, every command scored exactly"
    endchoice

    choice AI_ENGINE_NS_BACKEND
        prompt "ns net (KEHOACH 3.9, ADR-0047, ADR-0048)"
        default AI_ENGINE_NS_BACKEND_NONE
        help
            Which learned net builds into ai_engine for dsp_afe's ns slot; the model image names its ns entry after
            it. NVS afe/ns_engine picks the OM-LSA floor or this net at run time.

        config AI_ENGINE_NS_BACKEND_NONE
            bool "none: src/ns/, no net; the slot runs the floor"

        config AI_ENGINE_NS_BACKEND_GTCRN
            bool "gtcrn: src/ns_gtcrn/, GTCRN in float32 C, 99.5 KB of weights"

        config AI_ENGINE_NS_BACKEND_ULUNAS
            bool "ulunas: src/ns_ulunas/, UL-UNAS in float32 C, 590 KB of weights"
    endchoice

    choice AI_ENGINE_CORES
        prompt "cores ai_engine's own ops run on (KEHOACH 5.1, ADR-0027)"
        default AI_ENGINE_CORES_ONE
        help
            Which src/core/espdl/runtime/espdl_split_*.cpp builds into ai_engine. With two, main creates phu_task
            on core 1 at priority 1, below thu and sach, and the ops that split hand it half their work.

        config AI_ENGINE_CORES_ONE
            bool "one: every op runs whole on the task running its network"

        config AI_ENGINE_CORES_TWO
            bool "two: each op runs half on the network's task and half on phu_task on core 1"
    endchoice

    choice AI_ENGINE_KERNELS
        prompt "kernels of ai_engine's own ops (KEHOACH 3.14, ADR-0045)"
        default AI_ENGINE_KERNELS_PIE if IDF_TARGET_ESP32S3
        default AI_ENGINE_KERNELS_C
        help
            Which kernels build into ai_engine: the hand-written PIE ones of the S3, or their plain C twins, the
            same bits on any chip that keeps the S3's numbers.

        config AI_ENGINE_KERNELS_PIE
            bool "pie: kernels/*_esp32s3.S"
            depends on IDF_TARGET_ESP32S3

        config AI_ENGINE_KERNELS_C
            bool "c: kernels/<family>_s8.c"
    endchoice

    config AI_ENGINE_LOAN_RESERVE_BYTES
        int "internal RAM the ops' loan leaves free (KEHOACH 6.5, ADR-0025)"
        default 0
        range 0 65536
        help
            Each run lends ai_engine's own ops the largest free internal block, at most what they asked for, less
            this many bytes, which other tasks may still allocate while the graph runs. None by default: the other
            tasks allocate from the rest of internal RAM, and an op whose weights miss the loan reads them from flash.

endmenu
```
