## firmware/main/Kconfig.projbuild
```kconfig
menu "esp-sr application"

    config APP_CONSOLE
        bool "Console that writes NVS over UART"
        default n
        help
            On in dev, bench and ci. A shipped build must not carry a console
            that can rewrite every NVS key (KEHOACH 6.2).

    choice APP_BOARD
        prompt "Board, which picks the pin table of app_config.h"
        default APP_BOARD_B
        help
            Board B has two INMP441 and no camera. Board C has one INMP441,
            a MAX98357A and an OV5640 (KEHOACH 2.1, 2.2).

        config APP_BOARD_B
            bool "Board B"
        config APP_BOARD_C
            bool "Board C"
    endchoice

    config APP_CAMERA_ENABLE
        bool "Camera and SD card: photographs and detect on command"
        depends on APP_BOARD_C
        default y
        help
            Board C's image path (KEHOACH 3.19). Off means drv_camera, drv_sd
            and svc_vision build empty and nhin_task is never created.

    config APP_SPEAKER_ENABLE
        bool "Speaker fitted: open I2S TX and run noi_task"
        default n
        help
            Board B has no amplifier until E10. Off means drv_audio opens RX
            only, noi_task is never created, and replies stay MQTT events
            (KEHOACH 2.1).

    config APP_MIC_COUNT
        int "INMP441 microphones on the I2S data line"
        range 1 2
        default 2
        help
            Board B has two. One runs dsp_afe as "M": no balance, no doa,
            no gsc or bss, and the raw stream as modes 9 and 10 (ADR-0042,
            KEHOACH 2.3).

    choice APP_MIC_SLOT
        prompt "I2S slot of the one microphone"
        depends on APP_MIC_COUNT = 1
        default APP_MIC_SLOT_LEFT
        help
            The INMP441's L/R pin picks it: to GND is left, to VDD right.
            Board B's ch1, its better microphone, is the right slot.

        config APP_MIC_SLOT_LEFT
            bool "Left: L/R to GND"
        config APP_MIC_SLOT_RIGHT
            bool "Right: L/R to VDD"
    endchoice

    config APP_PCM_SHIFT_FALLBACK
        int "Microphone right shift until calib/pcm_shift is measured"
        range 8 16
        default 16
        help
            drv_audio keeps the top 32 - shift bits of each INMP441 slot.
            test_apps/calib writes the measured value to NVS calib/pcm_shift,
            which wins over this one (KEHOACH 6.2).

    config SR_PROFILING
        bool "Per-module timing into the bench CSV"
        default n
        help
            On only in the bench profile, the one profile numbers are
            reported from (KEHOACH 4.5.8).

endmenu
```

## firmware/test_apps/board_c/main/Kconfig.projbuild
```kconfig
menu "board_c check"

    config APP_BOARD_C
        bool
        default y

    config APP_CAMERA_ENABLE
        bool
        default y

endmenu
```

## firmware/test_apps/board_c/sdkconfig.defaults
```kconfig
CONFIG_IDF_TARGET="esp32s3"
CONFIG_FREERTOS_HZ=1000
CONFIG_PARTITION_TABLE_CUSTOM=y
CONFIG_PARTITION_TABLE_CUSTOM_FILENAME="../../partitions.csv"
CONFIG_ESP_TASK_WDT_INIT=n
CONFIG_CAMERA_AF_SUPPORT=y
```

## firmware/test_apps/bss_live/main/Kconfig.projbuild
```kconfig
menu "bss_live"

    config BSS_LIVE_PCM_SHIFT_FALLBACK
        int "Microphone right shift until calib/pcm_shift is measured"
        range 8 16
        default 16
        help
            Same meaning as APP_PCM_SHIFT_FALLBACK of main: drv_audio keeps the
            top 32 - shift bits of each INMP441 slot. NVS calib/pcm_shift wins.

    config BSS_LIVE_SECONDS_MAX
        int "Longest run a job may ask for, in seconds"
        range 10 600
        default 600
        help
            Each second keeps one status line of test_report in RAM, and the
            stream stays open SVC_REPORT_STREAM_MAX_S at most.

    config BSS_LIVE_DELAY_MAX_S
        int "Longest delay of the output a job may ask for, in seconds"
        range 1 8
        default 8
        help
            The delayed output keeps the mean spectrum and both raw channels
            of this many seconds in PSRAM, about 190 KB a second (KEHOACH 3.8).

    config BSS_LIVE_WIFI_WAIT_S
        int "Seconds to wait for Wi-Fi before reporting it down"
        range 5 120
        default 30

endmenu
```

## firmware/test_apps/calib/sdkconfig.defaults
```kconfig
CONFIG_IDF_TARGET="esp32s3"
CONFIG_FREERTOS_HZ=1000
CONFIG_PARTITION_TABLE_CUSTOM=y
CONFIG_PARTITION_TABLE_CUSTOM_FILENAME="../../partitions.csv"
CONFIG_LOG_DEFAULT_LEVEL_INFO=y
```

## firmware/test_apps/capture/main/Kconfig.projbuild
```kconfig
menu "capture"

    config CAPTURE_DURATION_S
        int "Stream for this many seconds after the link comes up"
        range 10 3600
        default 1860
        help
            30 minutes plus a minute of margin, so a host session of 1800 s
            always ends before the board stops sending (E5-T12). Stays at or
            under SVC_REPORT_STREAM_MAX_S.

    config CAPTURE_PCM_SHIFT_FALLBACK
        int "Microphone right shift until calib/pcm_shift is measured"
        range 8 16
        default 16
        help
            Same meaning as APP_PCM_SHIFT_FALLBACK of main: drv_audio keeps the
            top 32 - shift bits of each INMP441 slot. NVS calib/pcm_shift wins.

    config CAPTURE_RADIO_OFF_S
        int "Record this many seconds with the radio off, then send them"
        range 0 60
        default 0
        help
            0 streams live, as E5-T12. Above 0, the app records that many seconds
            into sb_stream in PSRAM before Wi-Fi is started, then joins and sends
            them: the "Wi-Fi off" floor of E2-T4 (KEHOACH 7.4). 60 s of mode 2
            take about 3.9 MB of PSRAM. Set by sdkconfig.radio_off.

    config CAPTURE_REF_ENABLE
        bool "MAX98357A fitted: capture the speaker reference too, as mode 3"
        default n
        help
            Board B has no speaker, so it captures ch0 ch1 in mode 2 (KEHOACH 7.4).

endmenu
```

## firmware/test_apps/capture/sdkconfig.defaults
```kconfig
CONFIG_IDF_TARGET="esp32s3"
CONFIG_FREERTOS_HZ=1000
CONFIG_PARTITION_TABLE_CUSTOM=y
CONFIG_PARTITION_TABLE_CUSTOM_FILENAME="../../partitions.csv"
CONFIG_LOG_DEFAULT_LEVEL_INFO=y
CONFIG_NET_STREAM_ENABLE=y
CONFIG_SVC_REPORT_STREAM_MAX_S=3600
```

## firmware/test_apps/espsr_compare/main/Kconfig.projbuild
```kconfig
menu "espsr_compare"

    config ESPSR_COMPARE_PORT
        int "TCP port the board listens on for jobs (KEHOACH 3.16)"
        range 1024 65535
        default 7711
        help
            The PC connects to this port at the address the board prints once it has joined Wi-Fi.

endmenu
```
