## firmware/components/ai_engine/Kconfig
```kconfig
menu "ai_engine"

    choice AI_ENGINE_COMMAND_BACKEND
        prompt "command backend (KEHOACH 3.12, ADR-0012)"
        default AI_ENGINE_COMMAND_BACKEND_KWS
        help
            Which command directory builds into ai_engine; the model image names its command entries after it.

        config AI_ENGINE_COMMAND_BACKEND_KWS
            bool "kws: src/command/, a neutral shell until E11-T17 runs its net"

        config AI_ENGINE_COMMAND_BACKEND_CTC
            bool "ctc: src/command_ctc/, the streaming encoder and the constrained CTC decision"

        config AI_ENGINE_COMMAND_BACKEND_RNNT
            bool "rnnt: src/command_rnnt/, the ctc encoder with a predictor and a joiner, every command scored exactly"
    endchoice

    choice AI_ENGINE_CORES
        prompt "cores ai_engine's own ops run on (KEHOACH 5.1, ADR-0027)"
        default AI_ENGINE_CORES_ONE
        help
            Which src/core/espdl/runtime/espdl_split_*.cpp builds into ai_engine. With two, main creates phu_task
            on core 1 at priority 1, below thu and sach, and the ops that split hand it half their work.

        config AI_ENGINE_CORES_ONE
            bool "one: every op runs whole on the task running its network"

        config AI_ENGINE_CORES_TWO
            bool "two: each op runs half on the network's task and half on phu_task on core 1"
    endchoice

    config AI_ENGINE_LOAN_RESERVE_BYTES
        int "internal RAM the ops' loan leaves free (KEHOACH 6.5, ADR-0025)"
        default 0
        range 0 65536
        help
            Each run lends ai_engine's own ops the largest free internal block, at most what they asked for, less
            this many bytes, which other tasks may still allocate while the graph runs. None by default: the other
            tasks allocate from the rest of internal RAM, and an op whose weights miss the loan reads them from flash.

endmenu
```

## firmware/components/ai_engine/test_apps/unit/sdkconfig.defaults
```kconfig
CONFIG_IDF_TARGET="esp32s3"
CONFIG_FREERTOS_HZ=1000
CONFIG_UNITY_ENABLE_IDF_TEST_RUNNER=y
CONFIG_COMPILER_STACK_CHECK_MODE_STRONG=y
CONFIG_ESP_MAIN_TASK_STACK_SIZE=8192
CONFIG_PARTITION_TABLE_CUSTOM=y
CONFIG_PARTITION_TABLE_CUSTOM_FILENAME="../../../../partitions.csv"
CONFIG_AI_ENGINE_COMMAND_BACKEND_CTC=y
```

## firmware/components/drv_audio/test_apps/unit/sdkconfig.defaults
```kconfig
CONFIG_IDF_TARGET="esp32s3"
CONFIG_FREERTOS_HZ=1000
CONFIG_UNITY_ENABLE_IDF_TEST_RUNNER=y
CONFIG_COMPILER_STACK_CHECK_MODE_STRONG=y
CONFIG_ESP_MAIN_TASK_STACK_SIZE=8192
```

## firmware/components/dsp_afe/Kconfig
```kconfig
menu "dsp_afe"
    # Switches only: the numbers of each module live in contracts/afe.yaml (gen_afe.h).

    config DSP_AFE_HPF_ENABLE
        bool "hpf: Butterworth high-pass per microphone (KEHOACH 3.4)"
        default n
        help
            Adds src/hpf.c to the build. The file is a neutral shell until E7-T1.

    config DSP_AFE_AEC_ENABLE
        bool "aec: multidelay echo canceller, needed for the MMR format (KEHOACH 3.5)"
        default n
        help
            Adds src/aec.c to the build. The file is a neutral shell until E10-T4.

    config DSP_AFE_BALANCE_ENABLE
        bool "balance: calibrated complex gain per bin for ch1 (KEHOACH 3.4)"
        default n
        help
            Adds src/balance.c to the build. The file is a neutral shell until E7-T2.

    config DSP_AFE_DOA_ENABLE
        bool "doa: GCC-PHAT searched over an angle grid (KEHOACH 3.6)"
        default n
        help
            Adds src/doa.c to the build. The file is a neutral shell until E8-T1.

    config DSP_AFE_GSC_ENABLE
        bool "gsc: two-microphone sidelobe canceller steered by doa (KEHOACH 3.7)"
        default n
        help
            Adds src/gsc.c to the build, for dsp_afe_config_t.spatial = DSP_AFE_SPATIAL_GSC.
            The file is a neutral shell until E8-T2.

    config DSP_AFE_BSS_ENABLE
        bool "bss: online AuxIVA for two sources (KEHOACH 3.8)"
        default n
        help
            Adds src/bss.c to the build, for dsp_afe_config_t.spatial = DSP_AFE_SPATIAL_BSS.
            The file is a neutral shell until E8-T3.

    config DSP_AFE_NS_OMLSA_ENABLE
        bool "ns_omlsa: OM-LSA plus IMCRA floor of the ns slot (KEHOACH 3.9)"
        default n
        help
            Adds src/ns_omlsa.c to the build; dsp_afe_config_t.ns = NULL then selects it.
            The file is a neutral shell until E9-T1.

    config DSP_AFE_VAD_ENABLE
        bool "vad: two-class GMM on six sub-bands (KEHOACH 3.10)"
        default n
        help
            Adds src/vad.c to the build. The file is a neutral shell until E7-T3.

    config DSP_AFE_AGC_ENABLE
        bool "agc: slow level gain plus look-ahead limiter (KEHOACH 3.10)"
        default n
        help
            Adds src/agc.c to the build. The file is a neutral shell until E7-T4.

endmenu
```

## firmware/components/dsp_spec/Kconfig
```kconfig
menu "dsp_spec"

    choice DSP_SPEC_FFT_BACKEND
        prompt "FFT under the STFT, log-mel and aec (KEHOACH 3.1, ADR-0020)"
        default DSP_SPEC_FFT_RADIX4
        help
            Picks the one source file of the real FFT that goes into the build.

        config DSP_SPEC_FFT_RADIX4
            bool "hand-written radix 4, bit for bit with srpipe.dsp.spec.fft"
            help
                Adds src/fft.c, its tables in the caller's memory. The stft and mel goldens and Gate 3 on the
                chip match Python exactly only with this FFT (KEHOACH 3.14).

        config DSP_SPEC_FFT_DL_FFT
            bool "dl_fft 0.7.0"
            help
                Adds src/fft_dl.c. dl_fft allocates its own tables in internal RAM at init (KEHOACH 4.5.3
                rule 7); on the S3 it runs fused multiply-adds and newlib's cosf and sinf, so the features no
                longer match the Python mirror bit for bit. Kept to compare against.
    endchoice

endmenu
```

## firmware/components/dsp_spec/test_apps/unit/sdkconfig.defaults
```kconfig
CONFIG_IDF_TARGET="esp32s3"
CONFIG_FREERTOS_HZ=1000
CONFIG_UNITY_ENABLE_IDF_TEST_RUNNER=y
CONFIG_ESP_MAIN_TASK_STACK_SIZE=16384
CONFIG_COMPILER_OPTIMIZATION_PERF=y
CONFIG_ESP_TASK_WDT_TIMEOUT_S=30
```

## firmware/components/net_mqtt/Kconfig
```kconfig
menu "net_mqtt"

    config NET_MQTT_URI_FALLBACK
        string "Broker URI when NVS device/mqtt_uri is absent"
        default ""
        help
            Empty means no fallback: net_mqtt waits until device/mqtt_uri is
            set on the console (KEHOACH 4.9, 6.2).

    config NET_MQTT_REQUIRE_TLS
        bool "Refuse any broker URI that is not mqtts://"
        default n
        help
            On in prod only (KEHOACH 4.5.8, 7.5).

    config NET_MQTT_KEEPALIVE_S
        int "MQTT keepalive in seconds"
        range 5 300
        default 15
        help
            The broker publishes the offline will about 1.5 keepalives after
            the board goes silent, so this bounds how late a power cut shows.

    config NET_MQTT_JSON_ARENA_BYTES
        int "Bytes of each of the two JSON arenas in PSRAM"
        range 2048 65535
        default 49152
        help
            One arena for the esp-mqtt task, one for the task that publishes
            (FREERTOS.md 14 P1); heartbeat reports the peak. The esp-mqtt task
            parses down/commands in its arena: a set at the limits of
            command_set.schema.json, 64 commands of 64 escaped characters,
            needs about 43 KB of cJSON nodes and strings.

endmenu
```

## firmware/components/net_stream/Kconfig
```kconfig
menu "net_stream"

    config NET_STREAM_ENABLE
        bool "TCP audio stream to a host, for data capture and debugging"
        default n
        help
            On in dev, bench and ci, off in prod: a device in a room must not
            have a path that pushes raw speech out (KEHOACH 4.5.8, 7.5). Off
            removes net_stream, luong_task and sb_stream from the image.

    config NET_STREAM_CONNECT_TIMEOUT_MS
        int "Give up a TCP connect after this many ms"
        depends on NET_STREAM_ENABLE
        range 200 10000
        default 2000

    config NET_STREAM_SEND_TIMEOUT_MS
        int "Give up sending one frame after this many ms and drop the connection"
        depends on NET_STREAM_ENABLE
        range 50 5000
        default 1000

endmenu
```

## firmware/components/svc_listen/Kconfig
```kconfig
menu "svc_listen"

    config SVC_LISTEN_CMD_REJECT_PERMILLE
        int "NVS kws/cmd_reject when the model image carries no delta1: thousandths of a nat a frame"
        range 0 65535
        default 300
        help
            The best command is turned down when the free unit loop scores better by more than this a frame
            (KEHOACH 3.12, 6.2). An image whose header carries the pair chosen for its command seeds that pair
            instead (KEHOACH 6.3). 300 is the delta1 Gate 3 was counted at (docs/measurements/command.md 2).

    config SVC_LISTEN_CMD_MARGIN_PERMILLE
        int "NVS kws/cmd_margin when the model image carries no delta2: thousandths of a nat a frame"
        range 0 65535
        default 50
        help
            The best command must lead the second by at least this a frame (KEHOACH 3.12, 6.2), unless the model
            image carries the pair chosen for its command (KEHOACH 6.3). 50 is the delta2 Gate 3 was counted at
            (docs/measurements/command.md 2).

    config SVC_LISTEN_CMD_SYLLABLE_PERMILLE
        int "NVS kws/cmd_syllable when the model image carries no delta3: thousandths of a nat a frame"
        range 1 65535
        default 65535
        help
            A command of two syllables or more is turned down when its worst syllable falls short of the free
            unit loop by more than this a frame (KEHOACH 3.12, 6.2), unless the model image carries the delta3
            chosen for its command (KEHOACH 6.3). 65535 caps nothing, as a model chosen without delta3 decides.

    config SVC_LISTEN_WAKE_PERMILLE
        int "NVS kws/wake_th when the model image carries no wake threshold: permille of the smoothed score"
        range 1 1000
        default 950
        help
            With a wake in the image, svc_listen leaves NGHE for LENH when the wake's smoothed score reaches
            this (KEHOACH 3.11, 5.4). An image whose header carries the threshold chosen for its wake seeds
            that one instead (KEHOACH 6.3).

    config SVC_LISTEN_COMMAND_WAIT_MS
        int "Milliseconds LENH waits for an utterance before going back to NGHE"
        range 100 10000
        default 3000
        help
            With a wake in the image, svc_listen goes back to NGHE when no utterance has run this long after
            the wake or after the last utterance (KEHOACH 5.4). It lives here, not in listen.yaml, whose hash
            the command model is held to.

    config SVC_LISTEN_WAKE_LEAD_MS
        int "Milliseconds of lead a command window the wake's mark cuts short is topped up to"
        range 0 2000
        default 500
        help
            In LENH a command window may not reach back past the hop after the wake's decision. When that
            leaves it less lead than this ahead of its speech, svc_listen tops the lead up with the hops right
            ahead of the wake word (KEHOACH 5.4, ADR-0032); 0 never tops up. Each topped-up hop is network
            work the decision waits for. It lives here, not in listen.yaml, whose hash the command model is
            held to.

    config SVC_LISTEN_WAKE_END_MS
        int "Milliseconds the wake's smoothed score stays over wake_th past the end of the wake word"
        range 0 1000
        default 224
        help
            In LENH the mark no command window reaches back past is the end of the wake word: the frame where
            the wake's smoothed score falls back under wake_th, less this, and never before the hop after the
            crossing (KEHOACH 5.4, ADR-0039). 224 ms is what puts the fewest marks inside "happy" on happy1's
            val_pos (docs/measurements/wake.md section 10); a new wake word or model is measured again.

    config SVC_LISTEN_WAKE_FALL_MS
        int "Milliseconds after a wake crossing its score has to fall back under wake_th to move the mark"
        range 0 5000
        default 768
        help
            A score still over wake_th this long after it crossed leaves the mark at the hop after the
            crossing, as does an utterance that closes first (KEHOACH 5.4, ADR-0039).

    config SVC_LISTEN_ENROL_WINDOW_S
        int "Seconds a speaker enrolment stays open for its commands"
        range 30 3600
        default 180
        help
            An enrolment that has not taken its commands this long after its ENROL ends, so one left behind
            neither swallows later commands nor makes anyone's voice the enrolling person's (KEHOACH 3.17).
            make speaker-enrol waits as long, then cancels.

endmenu
```

## firmware/components/svc_listen/test_apps/unit/sdkconfig.defaults
```kconfig
CONFIG_IDF_TARGET="esp32s3"
CONFIG_FREERTOS_HZ=1000
CONFIG_UNITY_ENABLE_IDF_TEST_RUNNER=y
CONFIG_COMPILER_STACK_CHECK_MODE_STRONG=y
CONFIG_ESP_MAIN_TASK_STACK_SIZE=16384
CONFIG_PARTITION_TABLE_CUSTOM=y
CONFIG_PARTITION_TABLE_CUSTOM_FILENAME="../../../../test_apps/partitions_unit.csv"
CONFIG_AI_ENGINE_COMMAND_BACKEND_CTC=y
```

## firmware/components/svc_report/Kconfig
```kconfig
menu "svc_report"

    config SVC_REPORT_STREAM_MAX_S
        int "Close the audio stream by itself after this many seconds"
        depends on NET_STREAM_ENABLE
        range 10 7200
        default 600
        help
            Ten minutes unless opened again (KEHOACH 7.5). test_apps/capture
            raises it for its 30-minute sessions.

    config SVC_REPORT_STREAM_CHANNELS_MAX
        int "Widest stream frame this build sends, in channels"
        depends on NET_STREAM_ENABLE
        range 2 6
        default 4
        help
            Sizes the two frame buffers of the stream. Four covers modes 1-5;
            test_apps/bss_live raises it to 6 for mode 8, ch0 ch1 and four seats
            (KEHOACH 7.4). A mode wider than this is refused at start.

    config SVC_REPORT_STREAM_BUFFER_KB
        int "Size of sb_stream in PSRAM (KB)"
        depends on NET_STREAM_ENABLE
        range 16 4096
        default 512
        help
            About 5 s of mode 5 and 8 s of mode 2: enough to ride out the
            stalls of the link to the host measured on board B (KEHOACH 5.3).
            app_wiring of main and test_apps/capture both create it this size.

endmenu
```

## firmware/components/sys_storage/test_apps/unit/sdkconfig.defaults
```kconfig
CONFIG_IDF_TARGET="esp32s3"
CONFIG_FREERTOS_HZ=1000
CONFIG_UNITY_ENABLE_IDF_TEST_RUNNER=y
CONFIG_COMPILER_STACK_CHECK_MODE_STRONG=y
CONFIG_ESP_MAIN_TASK_STACK_SIZE=8192
CONFIG_PARTITION_TABLE_CUSTOM=y
CONFIG_PARTITION_TABLE_CUSTOM_FILENAME="../../../../partitions.csv"
CONFIG_GPTIMER_ISR_CACHE_SAFE=y
```
